#include <KMS.h>
#include <KM_Accessors.h>
#include <KM_Data.h>
#include <KM_EEPROM.h>
#include <MIDI.h>
#include <midi_Defs.h>
#include <midi_Message.h>
#include <midi_Namespace.h>
#include <midi_Settings.h>

#define WRITE_MIDI
//#define WRITE_TEST_DATA

#define BLINK_INTERVAL    50
#define ESPERA_EEPROM     2000
#define MAX_PACKET_TIME   50
#define PACKET_SIZE       200

#if defined(__AVR_ATmega1280__) || defined(__AVR_ATmega2560__)
#define MAX_PACKETS_NUM   20
#elif defined(__AVR_ATmega328P__) || defined(__AVR_ATmega32U4__)
#define MAX_PACKETS_NUM   5
#endif

#if defined(WRITE_MIDI)
MIDI_CREATE_DEFAULT_INSTANCE()
#endif
#if defined(WRITE_TEST_DATA)
static const byte test_data[] ={
  //Simple test, 3B x 1US/3I/3O
  //89, 84, 88, 1, 0, 0, 0, 0, 0, 0, 0, 0, 0,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 100

  //Full test, 4B x 1US/24I/24O
  //89, 84, 88, 1, 0, 0, 0, 0, 0, 0, 0, 0, 0,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 84
  //OK

  //MEGA config in Uno stress test (full payload)
  //89, 84, 88, 1, 0, 0, 0, 0, 0, 0, 0, 0, 0,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 84
  //OK (Failed gracefully, YTX header was )

  //MEGA config in Uno stress test (incomplete bytes)
  //89, 84, 88, 1, 0, 0, 0, 0, 0, 0, 0, 0, 0,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 127
  //OK (Failed gracefully, only loaded 3 "real banks" out of configured 4)

  //Many outs test, 4B x 1US/1I/59O
  89, 84, 88, 1, 0, 0, 0, 0, 0, 0, 0, 0,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 84
};
#endif
const byte *pMsg;
//const byte *dataBuffer[MAX_PACKETS_NUM];
int sysexLength;
unsigned int dataIndex[MAX_PACKETS_NUM];
byte dataToWrite;
byte dataBuffer[400];

bool flagBlink = 0, flagWait = 0, receiving = 0;
byte blinkCount = 0;
unsigned long millisAnt = 0;

static const char * const modeLabels[] = {
    "Off"
  , "Note"
  , "CC"
  , "NRPN"
  , "PC"
  , "Shifter"
};
#define MODE_LABEL(m)   ((m) <= KMS::M_SHIFTER ? modeLabels[m] : "???")


void printGlobalData(const char *lbl, const KMS::GlobalData &d) {
  DEBUG_PRINT(lbl, "");
  DEBUG_PRINT("\t[byte length]", d.length);
  DEBUG_PRINT("\tIs Valid", d.isValid() ? "true" : "false");
  DEBUG_PRINT("\tProtocol version", d.protocolVersion());
  DEBUG_PRINT("\tHas Output Matrix", d.hasOutputMatrix() ? "true" : "false");
  DEBUG_PRINT("\tNum banks", d.numBanks());
  DEBUG_PRINT("\tNum inputs normal", d.numInputsNorm());
  DEBUG_PRINT("\tNum outputs", d.numOutputs());
}

void printInputNorm(const char *lbl, const KMS::InputNorm &d, int i) {
  DEBUG_PRINT(lbl, i);
  DEBUG_PRINT("\t[byte length]", d.length);
  DEBUG_PRINT("\tAnalog", d.analog() ? "analog" : "digital");

  DEBUG_PRINT("\tMode", MODE_LABEL(d.mode()));
  DEBUG_PRINT("\tChannel", d.channel()+1);          // channel 1-16
  DEBUG_PRINT("\tParam fine (nrpn)", d.param_fine());
    DEBUG_PRINT("\tParam coarse", d.param_coarse());
    DEBUG_PRINT("\tParam full NRPN", (d.param_coarse() << 7) | d.param_fine());
    DEBUG_PRINT("\tMin", d.param_min_coarse());
    DEBUG_PRINT("\tMax", d.param_max_coarse());
}

void printInputUS(const char *lbl, const KMS::InputUS &d, int i) {
  DEBUG_PRINT(lbl, i);
  DEBUG_PRINT("\t[byte length]", d.length);
  DEBUG_PRINT("\tDist Min", d.dist_min());
  DEBUG_PRINT("\tDist Max", d.dist_max());

  DEBUG_PRINT("\tMode", MODE_LABEL(d.mode()));
  DEBUG_PRINT("\tChannel", d.channel()+1);        // channel 1-16
  DEBUG_PRINT("\tParam fine (nrpn)", d.param_fine());
  DEBUG_PRINT("\tParam coarse", d.param_coarse());
//  DEBUG_PRINT("\tParam full NRPN", (d.param_coarse() << 7) | d.param_fine());
//  DEBUG_PRINT("\tParam Min", d.param_min_coarse());
//  DEBUG_PRINT("\tParam Max", d.param_max_coarse());
}

void printOutput(const char *lbl, const KMS::Output &d, int i) {
    DEBUG_PRINT(lbl, i);
    DEBUG_PRINT("\t[byte length]", d.length);
    DEBUG_PRINT("\tChannel", d.channel());          // channel 1-16
    DEBUG_PRINT("\tNote", d.note());
    DEBUG_PRINT("\tBlink", d.blink());
    DEBUG_PRINT("\tBlink Min", d.blink_min());
    DEBUG_PRINT("\tBlink Max", d.blink_max());
}

void setup() {
  // put your setup code here, to run once:
  #if defined(WRITE_MIDI)
  //MIDI.setHandleSystemExclusive(handle_sysex);
  MIDI.begin(MIDI_CHANNEL_OMNI); MIDI.turnThruOff();
  #else
  Serial.begin(115200); 
  #endif
  
  
    
  #if !defined(WRITE_MIDI) && !defined(WRITE_TEST_DATA)
   KMS::initialize();
   KMS::GlobalData gd = KMS::globalData();
    printGlobalData("Global data", gd);
    DEBUG_PRINT("real banks", KMS::realBanks());
    for(byte bank = 0; bank < KMS::realBanks(); bank++) {
      DEBUG_PRINT("---------------------BANK #", bank);
      KMS::setBank(bank);

      printInputUS("Input US", KMS::ultrasound(), 0);
      byte count = gd.numInputsNorm();
      for(byte i = 0; i<count; i++) {
        printInputNorm("Input Norm", KMS::input(i), i);
      }
      count = gd.numOutputs();
      for(byte i = 0; i<count; i++) {
        printOutput("Output", KMS::output(i), i);
      }
    }
//    for(byte i = 0; i<MAX_PACKETS_NUM; i++) {
//      dataBuffer[i] = NULL;
//      sysexLength[i] = 0;
//    }
//  unsigned int len = KMS::io.length();
//  unsigned int address = 0;
//  while(len--)
//    Serial.println(EEPROM.read(address++));
  #endif
  #if !defined(WRITE_MIDI) && defined(WRITE_TEST_DATA)
  unsigned long antMicros = micros();
  KMS::io.write(0, test_data, 1000);
  Serial.print("EEPROM escrita en ");Serial.print(millis()-antMicros);Serial.println(" us");
  Serial.println(sizeof(test_data));
  #endif
}

void loop() {

  
  // put your main code here, to run repeatedly:
#if defined(WRITE_MIDI) && !defined(WRITE_TEST_DATA)
  static bool lastLEDState = LOW;
  static unsigned long millisPrev = 0;
  static bool firstTime = true;
  
//  if(flagBlink && blinkCount){
//    if (firstTime){ firstTime = false; millisPrev = millis(); }
//    if(millis()-millisPrev > BLINK_INTERVAL){
//      millisPrev = millis();
//      digitalWrite(13, !lastLEDState);
//      lastLEDState = !lastLEDState;
//      if(lastLEDState == LOW) blinkCount--;
//      if(!blinkCount){ flagBlink = 0; firstTime = true; }
//    }
//  }
  
  if (MIDI.read()){                // If we have received a message
    if(MIDI.getType() == midi::SystemExclusive){
      sysexLength = (int) MIDI.getSysExArrayLength(); 
      pMsg = MIDI.getSysExArray();
      
      char sysexID[3];
      sysexID[0] = (char) pMsg[1]; 
      sysexID[1] = (char) pMsg[2]; 
      sysexID[2] = (char) pMsg[3];
        
      char command = pMsg[4];
      
      if(sysexID[0] == 'Y' && sysexID[1] == 'T' && sysexID[2] == 'X'){

        if (command == 1){            // Enter config mode
          for(int i=0; i<3;i++){
            flagBlink = 1;
            blinkCount = 1;
           //configMode = 1;
          }
        }                             
//          
        if(command == 3 ){             // Save dump data
          KMS::io.write(200*pMsg[5], pMsg+6, sysexLength-7);            
//          byte index = pMsg[5];
//          dataIndex[index] = index;
          MIDI.sendNoteOn(pMsg[5],127,1);
//          MIDI.sendPitchBend((int) (millis()-antMillisRead),1);
//          sysexLength[index] = (int) MIDI.getSysExArrayLength(); 
//          memcpy(dataBuffer+PACKET_SIZE*index,pMsg+6,sysexLength[index]-7);
//          receiving = true;
//          antMillisLastPacket = millis();
          flagBlink = 1;
          blinkCount = 2; 
        }
      }
    }  
  }  
#endif
}
//void EEPROM_IO_WRITE(int address, const byte *buf, int len) {
//    address += KMS_DATA_START;
//    while(len--)
//      EEPROM.update(address++, *(buf++));   //Update only writes if the value changed (extends EEPROM lifetime)
//  }
